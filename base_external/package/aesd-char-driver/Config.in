## base_external/package/aesd-char-driver/Config.in
```kconfig
config BR2_PACKAGE_AESD_CHAR_DRIVER
    bool "aesd-char-driver"
    help
      Kernel module for aesdchar device driver
```

## base_external/package/ldd/Config.in
```kconfig
config BR2_PACKAGE_LDD
    bool "ldd"
    help
      Misc modules and skull for your system.
```
